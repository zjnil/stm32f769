## Config.in
```kconfig
source "$BR2_EXTERNAL_STM32F769_PATH/package/fbmark/Config.in"
source "$BR2_EXTERNAL_STM32F769_PATH/package/hello/Config.in"
```

## package/fbmark/Config.in
```kconfig
config BR2_PACKAGE_FBMARK_APP
	bool "fbmark"
	help
	  Benchmark for testing fb device.

	  https://github.com/caramelli/fbmark
```
